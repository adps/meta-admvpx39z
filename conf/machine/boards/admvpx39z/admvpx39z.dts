
/dts-v1/;
/include/ "zynqmp.dtsi"
/include/ "zynqmp-clk-ccf.dtsi"
/include/ "pl.dtsi"
/include/ "pcw.dtsi"
/ {
	chosen {
		bootargs = "earlycon clk_ignore_unused cpuidle.off=1";
		stdout-path = "serial0:115200n8";
	};
	aliases {
		ethernet0 = &gem1;
		ethernet1 = &gem3;
		serial0 = &uart0;
	};
	memory {
		device_type = "memory";
		reg = <0x0 0x0 0x0 0x80000000>, <0x00000008 0x00000000 0x1 0x80000000>;
	};
};

