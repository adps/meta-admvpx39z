## conf/layer.conf
```bitbake
# We have a conf and classes directory, add to BBPATH
BBPATH .= ":${LAYERDIR}"

# We have a recipes-* directories, add to BBFILES
BBFILES += "${LAYERDIR}/recipes-*/*/*.bb \
	${LAYERDIR}/recipes-*/*/*.bbappend"

BBFILE_COLLECTIONS += "admvpx39z"
BBFILE_PATTERN_admvpx39z = "^${LAYERDIR}/"
BBFILE_PRIORITY_admvpx39z = "6"
```

## conf/machine/admvpx39z.conf
```bitbake
#@TYPE: Machine
#@NAME: zynqmp-admvpx39z
#@DESCRIPTION: Machine support for ADM-VPX3-9Z2 oard.
#

require conf/machine/include/tune-zynqmp.inc
require conf/machine/include/machine-xilinx-default.inc
require conf/machine/include/machine-xilinx-board.inc
require conf/machine/include/machine-xilinx-qemu.inc

INITRAMFS_IMAGE = "adlnx-image"
INITRAMFS_IMAGE_BUNDLE = "1"

MACHINE_FEATURES = "rtc ext2 ext3 vfat usbhost mali"

# This machine has a qemu machine model
EXTRA_IMAGEDEPENDS += "qemu-native qemu-helper-native"
EXTRA_IMAGEDEPENDS += "qemu-xilinx-native qemu-devicetrees"

UBOOT_MACHINE = "xilinx_zynqmp_zcu102_revB_defconfig"

SERIAL_CONSOLE = "115200 ttyPS0"

SERIAL_CONSOLES_CHECK = "${SERIAL_CONSOLES}"

KERNEL_DEVICETREE = "xilinx/zynqmp-zcu102-revB.dtb"

PREFERRED_PROVIDER_virtual/kernel ?= "linux-xlnx"
PREFERRED_PROVIDER_virtual/bootloader ?= "u-boot-xlnx"

EXTRA_IMAGEDEPENDS += "\
		arm-trusted-firmware \
		"

# This machine has a QEMU model, runqemu setup:
QB_MACHINE = "-machine xlnx-zcu102"
QB_MEM = "-m 2048"
QB_OPT_APPEND = "-nographic -serial mon:stdio -serial null"
QB_TAP_OPT = "-netdev tap,id=net0,ifname=@TAP@,script=no,downscript=no -net nic -net nic -net nic -net nic,netdev=net0,macaddr=@MAC@"
QB_SLIRP_OPT = "-netdev user,id=net0 -net nic -net nic -net nic -net nic,netdev=net0"

#MACHINE_DEVICETREE := " \
#                admvpx39z/admvpx39z.dts \
#                admvpx39z/pcw.dtsi \
#                admvpx39z/zynqmp-clk-ccf.dtsi \
#                admvpx39z/zynqmp-clk.dtsi \
#                admvpx39z/zynqmp.dtsi \
#                admvpx39z/pl.dtsi \
#		"
```
